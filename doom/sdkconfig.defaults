## doom/sdkconfig.defaults
```kconfig
# Doom (PrBoom) port sdkconfig.defaults, targeting the LilyGO T-Display S3
# board - shares its physical flash/partition table with KaRadio32_4, and
# its bootloader/partition-table are only ever flashed once via KaRadio's
# own `idf.py flash` (see flash_all.sh); only this app's binary gets
# written separately, to the ota_1 partition.

# ── Target ────────────────────────────────────────────────────────────────────
CONFIG_IDF_TARGET="esp32s3"

# ── Flash ─────────────────────────────────────────────────────────────────────
CONFIG_ESPTOOLPY_FLASHMODE_QIO=y
CONFIG_ESPTOOLPY_FLASHFREQ_80M=y
CONFIG_ESPTOOLPY_FLASHSIZE_16MB=y
CONFIG_ESPTOOLPY_FLASHSIZE="16MB"

# ── Partition table - same physical table KaRadio32_4 uses ───────────────────
CONFIG_PARTITION_TABLE_CUSTOM=y
CONFIG_PARTITION_TABLE_CUSTOM_FILENAME="../partitions.ttgo_tdisplay_s3.csv"
CONFIG_PARTITION_TABLE_FILENAME="../partitions.ttgo_tdisplay_s3.csv"

# ── PSRAM (OctalPSRAM, CLK=GPIO30, CS=GPIO26) ────────────────────────────────
CONFIG_SPIRAM=y
CONFIG_SPIRAM_MODE_OCT=y
CONFIG_SPIRAM_TYPE_AUTO=y
CONFIG_SPIRAM_CLK_IO=30
CONFIG_SPIRAM_CS_IO=26
CONFIG_SPIRAM_SPEED_80M=y
CONFIG_SPIRAM_BOOT_INIT=y
CONFIG_SPIRAM_PRE_CONFIGURE_MEMORY_PROTECTION=y
CONFIG_SPIRAM_USE_MALLOC=y
CONFIG_SPIRAM_MEMTEST=y
CONFIG_SPIRAM_MALLOC_ALWAYSINTERNAL=16384
CONFIG_SPIRAM_MALLOC_RESERVE_INTERNAL=32768
CONFIG_SPIRAM_ALLOW_BSS_SEG_EXTERNAL_MEMORY=y
# No task (Doom included - see its stack allocation in app_main()) uses a
# PSRAM-resident stack, so CONFIG_SPIRAM_ALLOW_STACK_EXTERNAL_MEMORY stays
# off; its own Kconfig help text warns it shouldn't be combined with
# Bluetooth, which this app uses (BluetoothJoystick).

# ── Main task ─────────────────────────────────────────────────────────────────
CONFIG_ESP_MAIN_TASK_STACK_SIZE=6144
CONFIG_ESP_MAIN_TASK_AFFINITY_CPU0=y

# ── CPU frequency ─────────────────────────────────────────────────────────────
CONFIG_ESP_DEFAULT_CPU_FREQ_MHZ_240=y
CONFIG_ESP_DEFAULT_CPU_FREQ_MHZ=240

# ── Bluetooth (BluetoothJoystick - kept unchanged from the original) ─────────
CONFIG_BT_ENABLED=y
CONFIG_BT_BLUEDROID_ENABLED=y
CONFIG_BT_BLUEDROID_PINNED_TO_CORE_0=y
CONFIG_BT_BTC_TASK_STACK_SIZE=3072
CONFIG_BT_BTU_TASK_STACK_SIZE=4352
CONFIG_BT_BLE_ENABLED=y
CONFIG_BT_GATTS_ENABLE=y
CONFIG_BT_GATTC_ENABLE=y
CONFIG_BT_BLE_SMP_ENABLE=y
CONFIG_BT_BLE_SMP_BOND_NVS_FLASH=y
CONFIG_BT_ACL_CONNECTIONS=4
CONFIG_BT_SMP_MAX_BONDS=15
# BLE 5.0 features
CONFIG_BT_BLE_50_FEATURES_SUPPORTED=y
CONFIG_BT_BLE_50_EXTEND_ADV_EN=y
CONFIG_BT_BLE_50_PERIODIC_ADV_EN=y
CONFIG_BT_BLE_50_EXTEND_SCAN_EN=y
CONFIG_BT_BLE_50_EXTEND_SYNC_EN=y
CONFIG_BT_BLE_50_DTM_TEST_EN=y
# BLE 4.2 features (required by BluetoothJoystick APIs)
CONFIG_BT_BLE_42_FEATURES_SUPPORTED=y
CONFIG_BT_BLE_42_DTM_TEST_EN=y
CONFIG_BT_BLE_42_ADV_EN=y
CONFIG_BT_BLE_42_SCAN_EN=y
# BT log levels — WARNING only (reduce serial noise)
CONFIG_BT_LOG_HCI_TRACE_LEVEL_WARNING=y
CONFIG_BT_LOG_BTM_TRACE_LEVEL_WARNING=y
CONFIG_BT_LOG_L2CAP_TRACE_LEVEL_WARNING=y
CONFIG_BT_LOG_GAP_TRACE_LEVEL_WARNING=y
CONFIG_BT_LOG_GATT_TRACE_LEVEL_WARNING=y
CONFIG_BT_LOG_SMP_TRACE_LEVEL_WARNING=y
CONFIG_BT_LOG_BTIF_TRACE_LEVEL_WARNING=y
CONFIG_BT_LOG_BTC_TRACE_LEVEL_WARNING=y
# BT controller
CONFIG_BT_CTRL_PINNED_TO_CORE_0=y
CONFIG_BT_CTRL_BLE_MAX_ACT=6
CONFIG_BT_CTRL_DFT_TX_POWER_LEVEL_P9=y
CONFIG_BT_CTRL_BLE_ADV_REPORT_FLOW_CTRL_SUPP=y
CONFIG_BT_CTRL_BLE_SCAN_DUPL=y

# ── FreeRTOS ──────────────────────────────────────────────────────────────────
CONFIG_FREERTOS_HZ=100

# ── Newlib ────────────────────────────────────────────────────────────────────
CONFIG_NEWLIB_STDOUT_LINE_ENDING_CRLF=y
CONFIG_NEWLIB_STDIN_LINE_ENDING_CR=y

# ── Compiler (match original sdkconfig) ──────────────────────────────────────
CONFIG_COMPILER_OPTIMIZATION_DEBUG=y
CONFIG_COMPILER_OPTIMIZATION_ASSERTIONS_ENABLE=y
CONFIG_COMPILER_OPTIMIZATION_ASSERTION_LEVEL=2
```
